## boards/shields/sofle_dt/Kconfig.shield
```kconfig
# Copyright (c) 2020 Ryan Cross
# SPDX-License-Identifier: MIT

config SHIELD_SOFLE_DT_LEFT
    def_bool $(shields_list_contains,sofle_dt_left)

config SHIELD_SOFLE_DT_RIGHT
    def_bool $(shields_list_contains,sofle_dt_right)
```
